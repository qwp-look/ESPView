// ESPView M7-A — OledFb 实现（页式 framebuffer + 内置 8x8 紧凑字体）。
#include "oled_fb.h"

#include <cstring>

namespace espview {
namespace oled {

// ---- 内置 8x8 ASCII 字体（0x20..0x7E，共 95 字形）----
// 行优先存储：每个字形 8 字节，字节 r = 第 r 行，bit0 = 最左像素。
// 自包含、无外部资源；drawText 绘制时转置为页式列字节（bit0 = 页顶行）。
namespace {

constexpr uint8_t kFont8x8[95][8] = {
    { 0x00, 0x00, 0x00, 0x00, 0x00, 0x00, 0x00, 0x00 },   // ' '
    { 0x18, 0x3C, 0x3C, 0x18, 0x18, 0x00, 0x18, 0x00 },   // '!'
    { 0x36, 0x36, 0x00, 0x00, 0x00, 0x00, 0x00, 0x00 },   // '"'
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    { 0x6E, 0x3B, 0x00, 0x00, 0x00, 0x00, 0x00, 0x00 },   // '~'
};

}  // namespace

OledFb::OledFb() { clear(); }

void OledFb::clear() { std::memset(fb_, 0, kSizeBytes); }

void OledFb::fill(bool on) {
    std::memset(fb_, on ? 0xFF : 0x00, kSizeBytes);
}

bool OledFb::setPixel(int x, int y, bool on) {
    if (x < 0 || x >= kWidth || y < 0 || y >= kHeight) {
        return false;
    }
    const size_t idx = static_cast<size_t>((y >> 3) * kWidth + x);
    const uint8_t mask = static_cast<uint8_t>(1u << (y & 7));
    if (on) {
        fb_[idx] |= mask;
    } else {
        fb_[idx] &= static_cast<uint8_t>(~mask);
    }
    return true;
}

bool OledFb::getPixel(int x, int y) const {
    if (x < 0 || x >= kWidth || y < 0 || y >= kHeight) {
        return false;
    }
    const size_t idx = static_cast<size_t>((y >> 3) * kWidth + x);
    return (fb_[idx] & (1u << (y & 7))) != 0;
}

void OledFb::drawBorder() {
    for (int x = 0; x < kWidth; ++x) {
        setPixel(x, 0, true);
        setPixel(x, kHeight - 1, true);
    }
    for (int y = 0; y < kHeight; ++y) {
        setPixel(0, y, true);
        setPixel(kWidth - 1, y, true);
    }
}

void OledFb::drawCheckerboard(int cell) {
    if (cell <= 0) {
        return;
    }
    for (int y = 0; y < kHeight; ++y) {
        for (int x = 0; x < kWidth; ++x) {
            setPixel(x, y, ((x / cell) + (y / cell)) & 1);
        }
    }
}

const uint8_t* OledFb::fontGlyph(char c) {
    const unsigned char uc = static_cast<unsigned char>(c);
    if (uc < 0x20u || uc > 0x7Eu) {
        return kFont8x8[0];  // 空格
    }
    return kFont8x8[uc - 0x20u];
}

void OledFb::drawText(int x, int y, const char* text) {
    if (text == nullptr || x >= kWidth || y >= kHeight || x < 0 || y < 0) {
        return;
    }
    const int topPage = y >> 3;
    const int rowOffset = y & 7;
    int cx = x;
    for (const char* p = text; *p != '\0' && cx < kWidth; ++p) {
        const uint8_t* glyph = fontGlyph(*p);
        for (int col = 0; col < kFontWidth; ++col) {
            const int absX = cx + col;
            if (absX >= kWidth) {
                break;
            }
            // 行优先 → 列字节：bit r = 字形第 r 行在 col 位（bit0 = 最左）。
            uint8_t slice = 0;
            for (int r = 0; r < kFontHeight; ++r) {
                if ((glyph[r] >> col) & 1u) {
                    slice |= static_cast<uint8_t>(1u << r);
                }
            }
            fb_[topPage * kWidth + absX] |=
                static_cast<uint8_t>(slice << rowOffset);
            if (rowOffset != 0 && topPage + 1 < kPageCount) {
                fb_[(topPage + 1) * kWidth + absX] |=
                    static_cast<uint8_t>(slice >> (8 - rowOffset));
            }
        }
        cx += kFontWidth;
    }
}

const uint8_t* OledFb::page(int pageIndex) const {
    if (pageIndex < 0 || pageIndex >= kPageCount) {
        return nullptr;
    }
    return fb_ + pageIndex * kWidth;
}

uint8_t OledFb::byteAt(int pageIndex, int x) const {
    if (pageIndex < 0 || pageIndex >= kPageCount || x < 0 || x >= kWidth) {
        return 0;
    }
    return fb_[pageIndex * kWidth + x];
}

void OledFb::setByte(int pageIndex, int x, uint8_t v) {
    if (pageIndex < 0 || pageIndex >= kPageCount || x < 0 || x >= kWidth) {
        return;
    }
    fb_[pageIndex * kWidth + x] = v;
}

size_t glyphPixelCount(char c) {
    const uint8_t* g = OledFb::fontGlyph(c);
    size_t n = 0;
    for (int i = 0; i < OledFb::kFontHeight; ++i) {
        uint8_t b = g[i];
        while (b != 0) {
            b &= static_cast<uint8_t>(b - 1);
            ++n;
        }
    }
    return n;
}

}  // namespace oled
}  // namespace espview
